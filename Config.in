## Config.in
```kconfig
source "$BR2_EXTERNAL_DSC2_PATH/package/roonbridge/Config.in"
source "$BR2_EXTERNAL_DSC2_PATH/package/python-adafruit-bbio/Config.in"
source "$BR2_EXTERNAL_DSC2_PATH/package/python-deprecated/Config.in"
source "$BR2_EXTERNAL_DSC2_PATH/package/python-lumacore/Config.in"
source "$BR2_EXTERNAL_DSC2_PATH/package/python-lumaoled/Config.in"
source "$BR2_EXTERNAL_DSC2_PATH/package/python-pyftdi/Config.in"
source "$BR2_EXTERNAL_DSC2_PATH/package/python-pyserial/Config.in"
source "$BR2_EXTERNAL_DSC2_PATH/package/python-smbus2/Config.in"
```

## configs/dsc2_defconfig
```kconfig
BR2_arm=y
BR2_cortex_a8=y
BR2_TOOLCHAIN_EXTERNAL=y
BR2_TARGET_GENERIC_HOSTNAME="dsc2"
BR2_TARGET_GENERIC_ISSUE="Welcome to DSC2 OS"
BR2_TARGET_GENERIC_ROOT_PASSWD="root"
BR2_ROOTFS_OVERLAY="$(BR2_EXTERNAL_DSC2_PATH)/board/dsc2/rootfs-overlay"
BR2_ROOTFS_POST_BUILD_SCRIPT="$(BR2_EXTERNAL_DSC2_PATH)/board/dsc2/post-build.sh"
BR2_ROOTFS_POST_IMAGE_SCRIPT="support/scripts/genimage.sh"
BR2_ROOTFS_POST_SCRIPT_ARGS="-c $(BR2_EXTERNAL_DSC2_PATH)/board/dsc2/genimage.cfg"
BR2_LINUX_KERNEL=y
BR2_LINUX_KERNEL_CUSTOM_TARBALL=y
BR2_LINUX_KERNEL_CUSTOM_TARBALL_LOCATION="$(call github,beagleboard,linux,5.4.70-ti-rt-r20)/linux-5.4.70-ti-rt-r20.tar.gz"
BR2_LINUX_KERNEL_PATCH="$(BR2_EXTERNAL_DSC2_PATH)/board/dsc2/patches/linux/"
BR2_LINUX_KERNEL_USE_CUSTOM_CONFIG=y
BR2_LINUX_KERNEL_CUSTOM_CONFIG_FILE="$(BR2_EXTERNAL_DSC2_PATH)/board/dsc2/linux.config"
BR2_LINUX_KERNEL_DTS_SUPPORT=y
BR2_LINUX_KERNEL_INTREE_DTS_NAME="am335x-evm am335x-bone am335x-boneblack am335x-bonegreen am335x-evmsk am335x-boneblue"
BR2_LINUX_KERNEL_CUSTOM_DTS_PATH="$(BR2_EXTERNAL_DSC2_PATH)/board/dsc2/dts/BOTIC-00A0.dts $(BR2_EXTERNAL_DSC2_PATH)/board/dsc2/dts/BB-SPIDEV0-00A0.dts"
BR2_LINUX_KERNEL_DTB_OVERLAY_SUPPORT=y
BR2_LINUX_KERNEL_NEEDS_HOST_OPENSSL=y
BR2_PACKAGE_ALSA_UTILS=y
BR2_PACKAGE_ALSA_UTILS_SPEAKER_TEST=y
BR2_PACKAGE_PYTHON3=y
BR2_PACKAGE_PYTHON_AENUM=y
BR2_PACKAGE_PYTHON_NUMPY=y
BR2_PACKAGE_PYTHON_PILLOW=y
BR2_PACKAGE_PYTHON_PIP=y
BR2_PACKAGE_PYTHON_SPIDEV=y
BR2_PACKAGE_DROPBEAR=y
BR2_TARGET_ROOTFS_EXT2=y
BR2_TARGET_ROOTFS_EXT2_4=y
BR2_TARGET_ROOTFS_EXT2_LABEL=""
BR2_TARGET_ROOTFS_EXT2_SIZE="120M"
BR2_TARGET_UBOOT=y
BR2_TARGET_UBOOT_PATCH="$(BR2_EXTERNAL_DSC2_PATH)/board/dsc2/patches/uboot/"
BR2_TARGET_UBOOT_USE_CUSTOM_CONFIG=y
BR2_TARGET_UBOOT_CUSTOM_CONFIG_FILE="$(BR2_EXTERNAL_DSC2_PATH)/board/dsc2/uboot.config"
BR2_TARGET_UBOOT_NEEDS_DTC=y
# BR2_TARGET_UBOOT_FORMAT_BIN is not set
BR2_TARGET_UBOOT_FORMAT_IMG=y
BR2_TARGET_UBOOT_SPL=y
BR2_TARGET_UBOOT_SPL_NAME="MLO"
BR2_PACKAGE_HOST_DOSFSTOOLS=y
BR2_PACKAGE_HOST_GENIMAGE=y
BR2_PACKAGE_HOST_MTOOLS=y
BR2_PACKAGE_HOST_UBOOT_TOOLS=y
BR2_PACKAGE_HOST_UBOOT_TOOLS_FIT_SUPPORT=y
```

## package/botic-card/Config.in
```kconfig
config BR2_PACKAGE_BOTIC_CARD
		bool "botic-card"
		help
		  Botic card kernel module
```

## package/botic-codec/Config.in
```kconfig
config BR2_PACKAGE_BOTIC_CODEC
		bool "botic-codec"
		help
		  Botic codec kernel module
```

## package/python-adafruit-bbio/Config.in
```kconfig
config BR2_PACKAGE_PYTHON_ADAFRUIT_BBIO
	bool "python-adafruit-bbio"
	help
	  A module to control BeagleBone IO channels.

	  https://github.com/adafruit/adafruit-beaglebone-io-python/
```

## package/python-deprecated/Config.in
```kconfig
config BR2_PACKAGE_PYTHON_DEPRECATED
	bool "python-deprecated"
	select BR2_PACKAGE_PYTHON_WRAPT # runtime
	help
	  Python @deprecated decorator to deprecate old python
	  classes, functions or methods.

	  https://github.com/tantale/deprecated
```

## package/python-lumacore/Config.in
```kconfig
config BR2_PACKAGE_PYTHON_LUMACORE
	bool "python-lumacore"
	select BR2_PACKAGE_PYTHON_CBOR2 # runtime
	select BR2_PACKAGE_PYTHON_DEPRECATED # runtime
	select BR2_PACKAGE_PYTHON_PILLOW # runtime
	select BR2_PACKAGE_PYTHON_PYFTDI # runtime
	select BR2_PACKAGE_PYTHON_SMBUS2 # runtime
	help
	  A component library to support SBC display drivers.

	  https://github.com/rm-hull/luma.core
```

## package/python-lumaoled/Config.in
```kconfig
config BR2_PACKAGE_PYTHON_LUMAOLED
	bool "python-lumaoled"
	select BR2_PACKAGE_PYTHON_LUMACORE # runtime
	help
	  A small library to drive an OLED device with either
	  SSD1306, SSD1309, SSD1322, SSD1325, SSD1327, SSD1331,
	  SSD1351, SSD1362, SH1106 or WS0010 chipset.

	  https://github.com/rm-hull/luma.oled
```

## package/roonbridge/Config.in
```kconfig
config BR2_PACKAGE_ROONBRIDGE
		bool "roonbridge"
		help
		  Prebuilt Roon Bridge server
		select BR2_PACKAGE_ALSA_LIB

if BR2_PACKAGE_ROONBRIDGE

config BR2_PACKAGE_ROONBRIDGE_ARCH
		string "architecture for binaries"
		default "armv7hf" if BR2_ARM_CPU_ARMV7A
		help
		  Architecture for prebuilt RoonBridge binaries. See https://help.roonlabs.com/portal/en/kb/articles/linux-install for options.

endif
```
